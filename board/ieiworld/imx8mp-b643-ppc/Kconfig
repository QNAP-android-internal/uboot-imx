## board/ieiworld/imx8mp-b643-ppc/Kconfig
```kconfig
if TARGET_IMX8MP_B643_PPC

config SYS_BOARD
	default "imx8mp-b643-ppc"

config SYS_VENDOR
	default "ieiworld"

config SYS_CONFIG_NAME
	default "imx8mp-b643-ppc"

config IMX_CONFIG
	default "board/freescale/imx8mp_evk/imximage-8mp-lpddr4.cfg"

config IMX8MP_GP5_LOCK_UPDATE
	bool "Enable burn GP5_LOCK fuse at boot"
	help
	  Select to check the GP5_LOCK fuse and burn it to WP+OP

endif
```

## board/ieiworld/imx95-b0787-smarc/Kconfig
```kconfig
if TARGET_IMX95_B0787

config SYS_BOARD
	default "imx95-b0787-smarc"

config SYS_VENDOR
	default "ieiworld"

config SYS_CONFIG_NAME
	default "imx95_b0787"

config SWUPDATE
	bool "Enable SWUpdate dual-copy A/B boot support"
	help
	  Enable SWUpdate dual-copy (A/B) OTA boot environment variables
	  including bootslot selection, rollback, and bootcount support.

endif
```
