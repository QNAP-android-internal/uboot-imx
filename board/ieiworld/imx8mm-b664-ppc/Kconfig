## board/ieiworld/imx8mm-b664-ppc/Kconfig
```kconfig
if TARGET_IMX8MM_B664_PPC

config SYS_BOARD
	default "imx8mm-b664-ppc"

config SYS_VENDOR
	default "ieiworld"

config SYS_CONFIG_NAME
	default "imx8mm-b664-ppc"

source "board/freescale/common/Kconfig"

endif
```
